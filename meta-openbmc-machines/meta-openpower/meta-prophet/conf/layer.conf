## meta-openbmc-machines/meta-openpower/meta-prophet/conf/layer.conf
```bitbake
# We have a conf and classes directory, add to BBPATH
BBPATH .= ":${LAYERDIR}"

BBFILE_COLLECTIONS += "prophet"
BBFILE_PATTERN_prophet = ""
```
